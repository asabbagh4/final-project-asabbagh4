## build/conf/bblayers.conf
```bitbake
# POKY_BBLAYERS_CONF_VERSION is increased each time build/conf/bblayers.conf
# changes incompatibly
POKY_BBLAYERS_CONF_VERSION = "2"

BBPATH = "${TOPDIR}"
BBFILES ?= ""

BBLAYERS ?= " \
  /home/ejanla/Documents/Workspace/machine-vision-synchronome/poky/meta \
  /home/ejanla/Documents/Workspace/machine-vision-synchronome/poky/meta-poky \
  /home/ejanla/Documents/Workspace/machine-vision-synchronome/poky/meta-yocto-bsp \
  /home/ejanla/Documents/Workspace/machine-vision-synchronome/meta-raspberrypi \
  /home/ejanla/Documents/Workspace/machine-vision-synchronome/meta-openembedded/meta-oe \
  /home/ejanla/Documents/Workspace/machine-vision-synchronome/meta-openembedded/meta-python \
  /home/ejanla/Documents/Workspace/machine-vision-synchronome/meta-openembedded/meta-networking \
  "
```
